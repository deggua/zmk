/*
 * Copyright (c) 2020 The ZMK Contributors
 *
 * SPDX-License-Identifier: MIT
 */

#include <dt-bindings/zmk/behaviors.h>

/ {
    behaviors {
    /omit-if-no-ref/ mwnd: move_window {
            compatible = "zmk,behavior-move-window";
            #binding-cells = <1>;
            display-name = "Move Window";
        };
    };
};
