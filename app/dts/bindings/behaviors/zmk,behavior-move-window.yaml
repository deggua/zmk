## app/dts/bindings/behaviors/zmk,behavior-move-window.yaml
```yaml
# Copyright (c) 2020 The ZMK Contributors
# SPDX-License-Identifier: MIT

description: Move window behavior

compatible: "zmk,behavior-move-window"

include: one_param.yaml
```
